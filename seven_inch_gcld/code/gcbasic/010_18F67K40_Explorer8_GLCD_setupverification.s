;Program compiled by GCBASIC (1.01.00 2023-09-30 (Windows 64 bit) : Build 1289) for Microchip PIC-AS using FreeBASIC 1.07.1/2023-10-18 CRC29
;  See the GCBASIC forums at http://sourceforge.net/projects/gcbasic/forums,
;  Check the documentation and Help at http://gcbasic.sourceforge.net/help/,
;or, email:
;   evanvennn at users dot sourceforge dot net

;********************************************************************************


;Set up the assembler options (Chip type, clock source, other bits and pieces)
;PROCESSOR   18F67K40
 PAGEWIDTH   180
 RADIX       DEC
 TITLE       "D:\GreatCowBASICGits\Help.git\trunk\seven_inch_gcld\code\grbasic\010_18F67K40_Explorer8_GLCD_setupverification.s"
 SUBTITLE    "10-21-2023"

; Reverse lookup file(s)
; C:\Program Files\Microchip\xc8\v2.45\pic\include\proc\pic18f67k40.inc
; C:\Program Files\Microchip\xc8\v2.45\pic\dat\cfgmap\18f67k40.cfgmap
; Alternative CONFIG file is to be found at C:\Program Files\Microchip\xc8\vX.YY\pic\dat\cfgdata as per Microchip support ticket #00730936 

;********************************************************************************
;Explicit PIC-AS constants to resolve the crazyness of the PIC-AS syntax
;These are therefore the same as MPASM
#define BANKED b
#define ACCESS a
#define UPPER low highword

;********************************************************************************
;Explicit CONFIG
 CONFIG CPD=OFF                                  ;C1 Reverselookup  CPD = OFF
 CONFIG CP=OFF                                   ;C1 Reverselookup  CP = OFF
 CONFIG LVP=OFF                                  ;C1 Reverselookup  LVP = OFF
 CONFIG WRTD=OFF                                 ;C1 Reverselookup  WRTD = OFF
 CONFIG WRTB=OFF                                 ;C1 Reverselookup  WRTB = OFF
 CONFIG WDTE=OFF                                 ;C1 Reverselookup  WDTE = OFF
 CONFIG XINST=OFF                                ;C1 Reverselookup  XINST = OFF
 CONFIG MCLRE=EXTMCLR                            ;C1 Reverselookup  MCLRE = EXTMCLR
 CONFIG FCMEN=ON                                 ;C1 Reverselookup  FCMEN = ON
 CONFIG CLKOUTEN=OFF                             ;C1 Reverselookup  CLKOUTEN = OFF
 CONFIG RSTOSC=HFINTOSC_1MHZ                     ;C1 Reverselookup  RSTOSC = HFINTOSC_1MHZ
 CONFIG FEXTOSC=OFF                              ;C1 Reverselookup  FEXTOSC = OFF
;Inferred CONFIG
 CONFIG BOREN=SBORDIS                            ;C1 Reverselookup BOREN=SBORDIS
 CONFIG BORV=VBOR_2P45                           ;C1 Reverselookup BORV=VBOR_2P45
 CONFIG CSWEN=ON                                 ;C1 Reverselookup CSWEN=ON
 CONFIG DEBUG=OFF                                ;C1 Reverselookup DEBUG=OFF
 CONFIG EBTR0=OFF                                ;C1 Reverselookup EBTR0=OFF
 CONFIG EBTR1=OFF                                ;C1 Reverselookup EBTR1=OFF
 CONFIG EBTR2=OFF                                ;C1 Reverselookup EBTR2=OFF
 CONFIG EBTR3=OFF                                ;C1 Reverselookup EBTR3=OFF
 CONFIG EBTR4=OFF                                ;C1 Reverselookup EBTR4=OFF
 CONFIG EBTR5=OFF                                ;C1 Reverselookup EBTR5=OFF
 CONFIG EBTR6=OFF                                ;C1 Reverselookup EBTR6=OFF
 CONFIG EBTR7=OFF                                ;C1 Reverselookup EBTR7=OFF
 CONFIG EBTRB=OFF                                ;C1 Reverselookup EBTRB=OFF
 CONFIG LPBOREN=OFF                              ;C1 Reverselookup LPBOREN=OFF
 CONFIG PPS1WAY=OFF                              ;C1 Reverselookup PPS1WAY=OFF
 CONFIG PWRTE=OFF                                ;C1 Reverselookup PWRTE=OFF
 CONFIG SCANE=ON                                 ;C1 Reverselookup SCANE=ON
 CONFIG STVREN=ON                                ;C1 Reverselookup STVREN=ON
 CONFIG WDTCCS=SC                                ;C1 Reverselookup WDTCCS=SC
 CONFIG WDTCPS=WDTCPS_31                         ;C1 Reverselookup WDTCPS=WDTCPS_31
 CONFIG WDTCWS=WDTCWS_7                          ;C1 Reverselookup WDTCWS=WDTCWS_7
 CONFIG WRT0=OFF                                 ;C1 Reverselookup WRT0=OFF
 CONFIG WRT1=OFF                                 ;C1 Reverselookup WRT1=OFF
 CONFIG WRT2=OFF                                 ;C1 Reverselookup WRT2=OFF
 CONFIG WRT3=OFF                                 ;C1 Reverselookup WRT3=OFF
 CONFIG WRT4=OFF                                 ;C1 Reverselookup WRT4=OFF
 CONFIG WRT5=OFF                                 ;C1 Reverselookup WRT5=OFF
 CONFIG WRT6=OFF                                 ;C1 Reverselookup WRT6=OFF
 CONFIG WRT7=OFF                                 ;C1 Reverselookup WRT7=OFF
 CONFIG WRTC=OFF                                 ;C1 Reverselookup WRTC=OFF
 CONFIG ZCD=OFF                                  ;C1 Reverselookup ZCD=OFF


;********************************************************************************
; The XC8 xc.inc include file.  This MUST be placed after the CONFIG statements.

 #include <xc.inc>

;********************************************************************************

;Set aside RAM memory locations for variables. All variables are global.
GLOBAL	BTNSTATE
 BTNSTATE                         EQU 10          ; 0XA
GLOBAL	COMPORT
 COMPORT                          EQU 11          ; 0XB
GLOBAL	DELAYTEMP
 DELAYTEMP                        EQU 0          ; 0X0
GLOBAL	DELAYTEMP2
 DELAYTEMP2                       EQU 1          ; 0X1
GLOBAL	GLCDBACKGROUND
 GLCDBACKGROUND                   EQU 12          ; 0XC
GLOBAL	GLCDBACKGROUND_H
 GLCDBACKGROUND_H                 EQU 13          ; 0XD
GLOBAL	GLCDDEVICEHEIGHT
 GLCDDEVICEHEIGHT                 EQU 14          ; 0XE
GLOBAL	GLCDDEVICEHEIGHT_H
 GLCDDEVICEHEIGHT_H               EQU 15          ; 0XF
GLOBAL	GLCDDEVICEWIDTH
 GLCDDEVICEWIDTH                  EQU 16          ; 0X10
GLOBAL	GLCDDEVICEWIDTH_H
 GLCDDEVICEWIDTH_H                EQU 17          ; 0X11
GLOBAL	GLCDFNTDEFAULT
 GLCDFNTDEFAULT                   EQU 18          ; 0X12
GLOBAL	GLCDFNTDEFAULTHEIGHT
 GLCDFNTDEFAULTHEIGHT             EQU 19          ; 0X13
GLOBAL	GLCDFNTDEFAULTSIZE
 GLCDFNTDEFAULTSIZE               EQU 20          ; 0X14
GLOBAL	GLCDFONTWIDTH
 GLCDFONTWIDTH                    EQU 21          ; 0X15
GLOBAL	GLCDFOREGROUND
 GLCDFOREGROUND                   EQU 22          ; 0X16
GLOBAL	GLCDFOREGROUND_H
 GLCDFOREGROUND_H                 EQU 23          ; 0X17
GLOBAL	GLCDROTATESTATE
 GLCDROTATESTATE                  EQU 24          ; 0X18
GLOBAL	HSERPRINTCRLFCOUNT
 HSERPRINTCRLFCOUNT               EQU 25          ; 0X19
GLOBAL	LCDBYTE
 LCDBYTE                          EQU 26          ; 0X1A
GLOBAL	LCDCOLUMN
 LCDCOLUMN                        EQU 27          ; 0X1B
GLOBAL	LCDLINE
 LCDLINE                          EQU 28          ; 0X1C
GLOBAL	LCDVALUE
 LCDVALUE                         EQU 29          ; 0X1D
GLOBAL	LCD_STATE
 LCD_STATE                        EQU 30          ; 0X1E
GLOBAL	PRINTLEN
 PRINTLEN                         EQU 31          ; 0X1F
GLOBAL	SERDATA
 SERDATA                          EQU 32          ; 0X20
GLOBAL	SPICLOCKMODE
 SPICLOCKMODE                     EQU 33          ; 0X21
GLOBAL	SPICURRENTMODE
 SPICURRENTMODE                   EQU 34          ; 0X22
GLOBAL	STRINGPOINTER
 STRINGPOINTER                    EQU 35          ; 0X23
GLOBAL	SWITCHEVENT
 SWITCHEVENT                      EQU 36          ; 0X24
GLOBAL	SYSBYTETEMPA
 SYSBYTETEMPA                     EQU 5          ; 0X5
GLOBAL	SYSBYTETEMPB
 SYSBYTETEMPB                     EQU 9          ; 0X9
GLOBAL	SYSBYTETEMPX
 SYSBYTETEMPX                     EQU 0          ; 0X0
GLOBAL	SYSCALCTEMPA
 SYSCALCTEMPA                     EQU 5          ; 0X5
GLOBAL	SYSLCDTEMP
 SYSLCDTEMP                       EQU 37          ; 0X25
GLOBAL	SYSPRINTDATAHANDLER
 SYSPRINTDATAHANDLER              EQU 38          ; 0X26
GLOBAL	SYSPRINTDATAHANDLER_H
 SYSPRINTDATAHANDLER_H            EQU 39          ; 0X27
GLOBAL	SYSPRINTTEMP
 SYSPRINTTEMP                     EQU 40          ; 0X28
GLOBAL	SYSREPEATTEMP1
 SYSREPEATTEMP1                   EQU 41          ; 0X29
GLOBAL	SYSREPEATTEMP2
 SYSREPEATTEMP2                   EQU 42          ; 0X2A
GLOBAL	SYSSTRINGA
 SYSSTRINGA                       EQU 7          ; 0X7
GLOBAL	SYSSTRINGA_H
 SYSSTRINGA_H                     EQU 8          ; 0X8
GLOBAL	SYSSTRINGLENGTH
 SYSSTRINGLENGTH                  EQU 6          ; 0X6
GLOBAL	SYSSTRINGPARAM1
 SYSSTRINGPARAM1                  EQU 3537          ; 0XDD1
GLOBAL	SYSTEMP1
 SYSTEMP1                         EQU 43          ; 0X2B
GLOBAL	SYSTEMP2
 SYSTEMP2                         EQU 44          ; 0X2C
GLOBAL	SYSWAITTEMP10US
 SYSWAITTEMP10US                  EQU 5          ; 0X5
GLOBAL	SYSWAITTEMPMS
 SYSWAITTEMPMS                    EQU 2          ; 0X2
GLOBAL	SYSWAITTEMPMS_H
 SYSWAITTEMPMS_H                  EQU 3          ; 0X3
GLOBAL	SYSWAITTEMPS
 SYSWAITTEMPS                     EQU 4          ; 0X4
GLOBAL	SYSWAITTEMPUS
 SYSWAITTEMPUS                    EQU 5          ; 0X5
GLOBAL	SYSWAITTEMPUS_H
 SYSWAITTEMPUS_H                  EQU 6          ; 0X6
GLOBAL	__LCDBYTE
 __LCDBYTE                        EQU 45          ; 0X2D
GLOBAL	__LCDREG
 __LCDREG                         EQU 46          ; 0X2E
GLOBAL	__LCD_OUTBUFFER
 __LCD_OUTBUFFER                  EQU 47          ; 0X2F
GLOBAL	__LCD_OUTBUFFERCOUNT
 __LCD_OUTBUFFERCOUNT             EQU 48          ; 0X30

;********************************************************************************

;ALIAS VARIABLES
GLOBAL	AFSR0
 AFSR0                            EQU 4073
GLOBAL	AFSR0_H
 AFSR0_H                          EQU 4074

;********************************************************************************

 PSECT   RESETVEC,delta=1, abs
 RESETVEC:
;VECTORS
	ORG	0
	GOTO	BASPROGRAMSTART
	ORG	8
	RETFIE

;********************************************************************************

;START OF PROGRAM MEMORY PAGE 0
	ORG	12
GLOBAL	BASPROGRAMSTART
BASPROGRAMSTART:
;CALL INITIALISATION ROUTINES
	RCALL	INITSYS
	RCALL	INITPPS
	RCALL	INITUSART
	RCALL	INITLCD
;AUTOMATIC PIN DIRECTION SETTING
	BCF	TRISA,0,ACCESS

;START OF THE MAIN PROGRAM
;
;A DEMONSTRATION PROGRAM FOR GCGB AND GCB.
;--------------------------------------------------------------------------------
;
;THE PROGRAM US DESIGNED FOR MICROCHIP�S EXPLORER 8 DEVELOPMENT BOARD. THE EXPLORER 8 DEVELOPMENT BOARD SUPPORTS 8/14/20/28/40-PIN 8-BIT PIC MICROCONTROLLERS AS WELL AS UP TO 80-PIN PIMMOUNTED DEVICES.
;THE DEMOS INCLUDED IN THIS DOCUMENT ARE DEVELOPED FOR HIGH PIN COUNT DEVICES (64 PIN).
;
;GCBASIC FOR THESE DEVICES CAN BE DOWNLOADED FROM THE GCBASIC WEB SITE AT HTTPS://SOURCEFORGE.NET/PROJECTS/GCBASIC/
;
;
;''AUTHOR    EVAN R. VENN
;''LICENSE   GPL
;''VERSION   1.02
;''DATE      2023-11-20
;''********************************************************************************
;PPS TOOL VERSION: 0.0.6.3
;GENERATED FOR 18F67K40
;CONSTANTS - SERIAL SUPPORT
;CONSTANTS - GLCD CONNECTIVITY TYPE;CONTROLS WHETHER TO USE HW SPI
;IF PPS ENABLED THEN PORTS MUST MATCH PPS CONFIG
;PORTS TO CONTROL GLCD
;CONSTANTS - LCD CONNECTIVITY TYPE;CONTROLS WHETHER TO USE HW SPI; THE INTER CHARACTER DELAY
;#DEFINE LCD_HARDWARESPI
;THESE ARE PHYISCAL CONNECTIONS FROM THE EXPANDER TO THE LCD.  THESE ARE AUTOMATICALLY SET IN THE LIBRARY AND ARE SHOWN HERE PURELY FOR CLARITY.
;PIN MAPPINGS FOR LCD IO SPI EXPANDER
;OPTIONAL(S) RESET PORT.PIN CONNECTION TO EXPANDER, SELECT ONE.
;#DEFINE LCD_SPI_RESET_IN       PORTB.5
;----- MAIN BODY OF PROGRAM COMMENCES HERE.
;HARDWARE CONFIGURATION
;DIR SWITCH_S1_PORT  IN
	BSF	TRISB,0,ACCESS
;DIR SWITCH_S2_PORT  IN
	BSF	TRISA,5,ACCESS
;DIR LED_D1          OUT
	BCF	TRISD,0,ACCESS
;DIR LED_D2          OUT
	BCF	TRISD,1,ACCESS
;DIR LED_D3          OUT
	BCF	TRISD,2,ACCESS
;DIR LED_D4          OUT
	BCF	TRISD,3,ACCESS
;DIR LED_D5          OUT
	BCF	TRISB,0,ACCESS
;DIR LED_D6          OUT
	BCF	TRISB,1,ACCESS
;DIR LED_D7          OUT
	BCF	TRISB,2,ACCESS
;DIR LED_D8          OUT
	BCF	TRISB,3,ACCESS
;DIR CCPPWM_D1       OUT
	BCF	TRISE,7,ACCESS
;DIR CCPPWM_D2       OUT
	BCF	TRISE,5,ACCESS
;DIR CCPPWM_D3       OUT
	BCF	TRISC,2,ACCESS
;ENSURE SPI_EXPANDER PORTS ARE OUTPUTS.  THESE WILL HAVE BEEN CHANGED DURING THE INIT PHASE OF THE CHIP.
;DIR LCD_SPI_DO      OUT: LCD_SPI_DO     = 0
	BCF	TRISC,5,ACCESS
;DIR LCD_SPI_DO      OUT: LCD_SPI_DO     = 0
	BCF	LATC,5,ACCESS
;DIR LCD_SPI_SCK     OUT: LCD_SPI_SCK    = 0
	BCF	TRISC,3,ACCESS
;DIR LCD_SPI_SCK     OUT: LCD_SPI_SCK    = 0
	BCF	LATC,3,ACCESS
;COMMON MACRO AND CONSTANTS
;VARIABLE DEFINITIONS
;DIM SWITCHEVENT AS BYTE:        SWITCHEVENT = 0
;DIM SWITCHEVENT AS BYTE:        SWITCHEVENT = 0
	CLRF	SWITCHEVENT,ACCESS
;DIM BTNSTATE AS BYTE:           BTNSTATE = NOT_PRESSED
;DIM BTNSTATE AS BYTE:           BTNSTATE = NOT_PRESSED
	CLRF	BTNSTATE,ACCESS
;HSERPRINTCRLF
	MOVLW	1
	MOVWF	HSERPRINTCRLFCOUNT,ACCESS
	MOVLW	1
	MOVWF	COMPORT,ACCESS
	RCALL	HSERPRINTCRLF
;HSERPRINT "WELCOME TO EXPLORER 8"
	LFSR	1,SYSSTRINGPARAM1
	MOVLW	LOW STRINGTABLE1
	MOVWF	TBLPTR,ACCESS
	MOVLW	HIGH STRINGTABLE1
	MOVWF	TBLPTRH,ACCESS
	MOVLW	UPPER STRINGTABLE1
	MOVWF	TBLPTRU,ACCESS
	RCALL	SYSREADSTRING
	MOVLW	LOW SYSSTRINGPARAM1
	MOVWF	SYSPRINTDATAHANDLER,ACCESS
	MOVLW	HIGH SYSSTRINGPARAM1
	MOVWF	SYSPRINTDATAHANDLER_H,ACCESS
	MOVLW	1
	MOVWF	COMPORT,ACCESS
;USING SYSSTRINGPARAM1*21
	RCALL	HSERPRINT815
;HSERPRINTCRLF
	MOVLW	1
	MOVWF	HSERPRINTCRLFCOUNT,ACCESS
	MOVLW	1
	MOVWF	COMPORT,ACCESS
	RCALL	HSERPRINTCRLF
;HSERPRINT "GCBASIC - ANOBIUM   2023"
	LFSR	1,SYSSTRINGPARAM1
	MOVLW	LOW STRINGTABLE2
	MOVWF	TBLPTR,ACCESS
	MOVLW	HIGH STRINGTABLE2
	MOVWF	TBLPTRH,ACCESS
	MOVLW	UPPER STRINGTABLE2
	MOVWF	TBLPTRU,ACCESS
	RCALL	SYSREADSTRING
	MOVLW	LOW SYSSTRINGPARAM1
	MOVWF	SYSPRINTDATAHANDLER,ACCESS
	MOVLW	HIGH SYSSTRINGPARAM1
	MOVWF	SYSPRINTDATAHANDLER_H,ACCESS
	MOVLW	1
	MOVWF	COMPORT,ACCESS
;USING SYSSTRINGPARAM1*24
	RCALL	HSERPRINT815
;HSERPRINTCRLF
	MOVLW	1
	MOVWF	HSERPRINTCRLFCOUNT,ACCESS
	MOVLW	1
	MOVWF	COMPORT,ACCESS
	RCALL	HSERPRINTCRLF
;PRINT "    WELCOME     "
	LFSR	1,SYSSTRINGPARAM1
	MOVLW	LOW STRINGTABLE3
	MOVWF	TBLPTR,ACCESS
	MOVLW	HIGH STRINGTABLE3
	MOVWF	TBLPTRH,ACCESS
	MOVLW	UPPER STRINGTABLE3
	MOVWF	TBLPTRU,ACCESS
	RCALL	SYSREADSTRING
	MOVLW	LOW SYSSTRINGPARAM1
	MOVWF	SYSPRINTDATAHANDLER,ACCESS
	MOVLW	HIGH SYSSTRINGPARAM1
	MOVWF	SYSPRINTDATAHANDLER_H,ACCESS
;USING SYSSTRINGPARAM1*16
	RCALL	PRINT612
;LOCATE 1,0
	MOVLW	1
	MOVWF	LCDLINE,ACCESS
	CLRF	LCDCOLUMN,ACCESS
	RCALL	LOCATE
;PRINT "  TO EXPLORER 8 "
	LFSR	1,SYSSTRINGPARAM1
	MOVLW	LOW STRINGTABLE4
	MOVWF	TBLPTR,ACCESS
	MOVLW	HIGH STRINGTABLE4
	MOVWF	TBLPTRH,ACCESS
	MOVLW	UPPER STRINGTABLE4
	MOVWF	TBLPTRU,ACCESS
	RCALL	SYSREADSTRING
	MOVLW	LOW SYSSTRINGPARAM1
	MOVWF	SYSPRINTDATAHANDLER,ACCESS
	MOVLW	HIGH SYSSTRINGPARAM1
	MOVWF	SYSPRINTDATAHANDLER_H,ACCESS
;USING SYSSTRINGPARAM1*16
	RCALL	PRINT612
;WAIT 1 S
	MOVLW	1
	MOVWF	SYSWAITTEMPS,ACCESS
	RCALL	DELAY_S
;CLS
	RCALL	CLS
;PRINT "    GCBASIC     "
	LFSR	1,SYSSTRINGPARAM1
	MOVLW	LOW STRINGTABLE5
	MOVWF	TBLPTR,ACCESS
	MOVLW	HIGH STRINGTABLE5
	MOVWF	TBLPTRH,ACCESS
	MOVLW	UPPER STRINGTABLE5
	MOVWF	TBLPTRU,ACCESS
	RCALL	SYSREADSTRING
	MOVLW	LOW SYSSTRINGPARAM1
	MOVWF	SYSPRINTDATAHANDLER,ACCESS
	MOVLW	HIGH SYSSTRINGPARAM1
	MOVWF	SYSPRINTDATAHANDLER_H,ACCESS
;USING SYSSTRINGPARAM1*16
	RCALL	PRINT612
;LOCATE 1,0
	MOVLW	1
	MOVWF	LCDLINE,ACCESS
	CLRF	LCDCOLUMN,ACCESS
	RCALL	LOCATE
;PRINT " ANOBIUM   2023 "
	LFSR	1,SYSSTRINGPARAM1
	MOVLW	LOW STRINGTABLE6
	MOVWF	TBLPTR,ACCESS
	MOVLW	HIGH STRINGTABLE6
	MOVWF	TBLPTRH,ACCESS
	MOVLW	UPPER STRINGTABLE6
	MOVWF	TBLPTRU,ACCESS
	RCALL	SYSREADSTRING
	MOVLW	LOW SYSSTRINGPARAM1
	MOVWF	SYSPRINTDATAHANDLER,ACCESS
	MOVLW	HIGH SYSSTRINGPARAM1
	MOVWF	SYSPRINTDATAHANDLER_H,ACCESS
;USING SYSSTRINGPARAM1*16
	RCALL	PRINT612
;WAIT 5 S
	MOVLW	5
	MOVWF	SYSWAITTEMPS,ACCESS
	RCALL	DELAY_S
;CLS
	RCALL	CLS
;PRINT "    WELCOME     "
	LFSR	1,SYSSTRINGPARAM1
	MOVLW	LOW STRINGTABLE3
	MOVWF	TBLPTR,ACCESS
	MOVLW	HIGH STRINGTABLE3
	MOVWF	TBLPTRH,ACCESS
	MOVLW	UPPER STRINGTABLE3
	MOVWF	TBLPTRU,ACCESS
	RCALL	SYSREADSTRING
	MOVLW	LOW SYSSTRINGPARAM1
	MOVWF	SYSPRINTDATAHANDLER,ACCESS
	MOVLW	HIGH SYSSTRINGPARAM1
	MOVWF	SYSPRINTDATAHANDLER_H,ACCESS
;USING SYSSTRINGPARAM1*16
	RCALL	PRINT612
;LOCATE 1,0
	MOVLW	1
	MOVWF	LCDLINE,ACCESS
	CLRF	LCDCOLUMN,ACCESS
	RCALL	LOCATE
;PRINT "  TO EXPLORER 8 "
	LFSR	1,SYSSTRINGPARAM1
	MOVLW	LOW STRINGTABLE4
	MOVWF	TBLPTR,ACCESS
	MOVLW	HIGH STRINGTABLE4
	MOVWF	TBLPTRH,ACCESS
	MOVLW	UPPER STRINGTABLE4
	MOVWF	TBLPTRU,ACCESS
	RCALL	SYSREADSTRING
	MOVLW	LOW SYSSTRINGPARAM1
	MOVWF	SYSPRINTDATAHANDLER,ACCESS
	MOVLW	HIGH SYSSTRINGPARAM1
	MOVWF	SYSPRINTDATAHANDLER_H,ACCESS
;USING SYSSTRINGPARAM1*16
	RCALL	PRINT612
;INITGLCD
	RCALL	INITGLCD_LT686
;
;DO FOREVER
;// CHECK BUTTON STATE
;CHECKBUTTONS2
;
;IF SWITCHEVENT = 1 THEN
;// DO STUFF
;END IF
;
;LOOP
;
;****************************************************************************************************************************************
;**************************************************************************************************
;PIN MAPPINGS FOR LT686
;''INITIALISE THE GLCD DEVICE
;SUB
;''CLEARS THE GLCD SCREEN
GLOBAL	BASPROGRAMEND
BASPROGRAMEND:
	SLEEP
	BRA	BASPROGRAMEND

;********************************************************************************

;SOURCE: LCD.H (510)
GLOBAL	CLS
CLS:
;SUB TO CLEAR THE LCD
;SET LCD_RS OFF
	BCF	SYSLCDTEMP,1,ACCESS
;CLEAR SCREEN
;LCDWRITEBYTE (0B00000001)
	MOVLW	1
	MOVWF	LCDBYTE,ACCESS
	RCALL	LCD_SPI_EXPANDER_NORMALWRITEBYTE
;WAIT 4 MS
	MOVLW	4
	MOVWF	SYSWAITTEMPMS,ACCESS
	CLRF	SYSWAITTEMPMS_H,ACCESS
	RCALL	DELAY_MS
;MOVE TO START OF VISIBLE DDRAM
;LCDWRITEBYTE(0X80)
	MOVLW	128
	MOVWF	LCDBYTE,ACCESS
	RCALL	LCD_SPI_EXPANDER_NORMALWRITEBYTE
;WAIT 50 US
	MOVLW	1
	MOVWF	DELAYTEMP2,ACCESS
GLOBAL	DELAYUSO2
DELAYUSO2:
	CLRF	DELAYTEMP,ACCESS
GLOBAL	DELAYUS2
DELAYUS2:
	DECFSZ	DELAYTEMP,F,ACCESS
	BRA	DELAYUS2
	DECFSZ	DELAYTEMP2,F,ACCESS
	BRA	DELAYUSO2
	MOVLW	9
	MOVWF	DELAYTEMP,ACCESS
GLOBAL	DELAYUS3
DELAYUS3:
	DECFSZ	DELAYTEMP,F,ACCESS
	BRA	DELAYUS3
	RETURN

;********************************************************************************

GLOBAL	DELAY_10US
DELAY_10US:
GLOBAL	D10US_START
D10US_START:
	MOVLW	52
	MOVWF	DELAYTEMP,ACCESS
GLOBAL	DELAYUS0
DELAYUS0:
	DECFSZ	DELAYTEMP,F,ACCESS
	BRA	DELAYUS0
	DECFSZ	SYSWAITTEMP10US, F,ACCESS
	BRA	D10US_START
	RETURN

;********************************************************************************

GLOBAL	DELAY_MS
DELAY_MS:
	INCF	SYSWAITTEMPMS_H, F,ACCESS
GLOBAL	DMS_START
DMS_START:
	MOVLW	129
	MOVWF	DELAYTEMP2,ACCESS
GLOBAL	DMS_OUTER
DMS_OUTER:
	MOVLW	40
	MOVWF	DELAYTEMP,ACCESS
GLOBAL	DMS_INNER
DMS_INNER:
	DECFSZ	DELAYTEMP, F,ACCESS
	BRA	DMS_INNER
	DECFSZ	DELAYTEMP2, F,ACCESS
	BRA	DMS_OUTER
	DECFSZ	SYSWAITTEMPMS, F,ACCESS
	BRA	DMS_START
	DECFSZ	SYSWAITTEMPMS_H, F,ACCESS
	BRA	DMS_START
	RETURN

;********************************************************************************

GLOBAL	DELAY_S
DELAY_S:
GLOBAL	DS_START
DS_START:
	MOVLW	232
	MOVWF	SYSWAITTEMPMS,ACCESS
	MOVLW	3
	MOVWF	SYSWAITTEMPMS_H,ACCESS
	RCALL	DELAY_MS
	DECFSZ	SYSWAITTEMPS, F,ACCESS
	BRA	DS_START
	RETURN

;********************************************************************************

;SOURCE: 010_18F67K40_EXPLORER8_GLCD_SETUPVERIFICATION.GCB (349)
GLOBAL	GLCDCLS_LT686
GLCDCLS_LT686:
	RETURN

;********************************************************************************

;OVERLOADED SIGNATURE: STRING:BYTE:, SOURCE: USART.H (2424)
GLOBAL	HSERPRINT815
HSERPRINT815:
;PRINTLEN = PRINTDATA(0)
	MOVFF	SYSPRINTDATAHANDLER,FSR0
	MOVFF	SYSPRINTDATAHANDLER_H,FSR0H
	MOVFF	INDF0,PRINTLEN
;IF PRINTLEN <> 0 THEN
	MOVF	PRINTLEN,F,ACCESS
	BTFSC	STATUS,2,ACCESS
	BRA	ENDIF12
;WRITE DATA
;FOR SYSPRINTTEMP = 1 TO PRINTLEN
	MOVLW	1
	MOVWF	SYSPRINTTEMP,ACCESS
GLOBAL	SYSFORLOOP3
SYSFORLOOP3:
;HSERSEND(PRINTDATA(SYSPRINTTEMP),COMPORT )
	MOVF	SYSPRINTTEMP,W,ACCESS
	ADDWF	SYSPRINTDATAHANDLER,W,ACCESS
	MOVWF	FSR0,ACCESS
	MOVLW	0
	ADDWFC	SYSPRINTDATAHANDLER_H,W,ACCESS
	MOVWF	FSR0H,ACCESS
	MOVFF	INDF0,SERDATA
	RCALL	HSERSEND805
;NEXT
;POSITIVE VALUE STEP HANDLER IN FOR-NEXT STATEMENT :#4P 
	MOVF	SYSPRINTTEMP,W,ACCESS
	SUBWF	PRINTLEN,W,ACCESS
	MOVWF	SYSTEMP1,ACCESS
	MOVFF	SYSTEMP1,SYSBYTETEMPA
	CLRF	SYSBYTETEMPB,ACCESS
	RCALL	SYSCOMPEQUAL
	COMF	SYSBYTETEMPX,F,ACCESS
	BTFSS	SYSBYTETEMPX,0,ACCESS
	BRA	ENDIF13
;SET LOOPVAR TO LOOPVAR + STEPVALUE WHERE STEPVALUE IS A POSITIVE VALUE
	INCF	SYSPRINTTEMP,F,ACCESS
	BRA	SYSFORLOOP3
;END IF
GLOBAL	ENDIF13
ENDIF13:
GLOBAL	SYSFORLOOPEND3
SYSFORLOOPEND3:
;END IF
GLOBAL	ENDIF12
ENDIF12:
;CR
;ALL USARTS
;--------------------------
;SPECIFIC USARTS
;------------------
	RETURN

;********************************************************************************

;SOURCE: USART.H (2632)
GLOBAL	HSERPRINTCRLF
HSERPRINTCRLF:
;REPEAT HSERPRINTCRLFCOUNT
	MOVFF	HSERPRINTCRLFCOUNT,SYSREPEATTEMP2
	MOVF	SYSREPEATTEMP2,F,ACCESS
	BTFSC	STATUS,2,ACCESS
	BRA	SYSREPEATLOOPEND2
GLOBAL	SYSREPEATLOOP2
SYSREPEATLOOP2:
;HSERSEND(13,COMPORT)
	MOVLW	13
	MOVWF	SERDATA,ACCESS
	RCALL	HSERSEND805
;HSERSEND(10,COMPORT)
	MOVLW	10
	MOVWF	SERDATA,ACCESS
	RCALL	HSERSEND805
;END REPEAT
	DECFSZ	SYSREPEATTEMP2,F,ACCESS
	BRA	SYSREPEATLOOP2
GLOBAL	SYSREPEATLOOPEND2
SYSREPEATLOOPEND2:
	RETURN

;********************************************************************************

;OVERLOADED SIGNATURE: BYTE:BYTE:, SOURCE: USART.H (1553)
GLOBAL	HSERSEND805
HSERSEND805:
GLOBAL	HSERSENDUSART1HANDLER
HSERSENDUSART1HANDLER:
;USART_TX_BLOCKING
;WAIT WHILE TXIF = OFF
GLOBAL	SYSWAITLOOP1
SYSWAITLOOP1:
	BANKSEL	PIR3
	BTFSS	PIR3,4,BANKED
	BRA	SYSWAITLOOP1
;WAIT UNTIL TRMT = 1
GLOBAL	SYSWAITLOOP2
SYSWAITLOOP2:
	BTFSS	TX1STA,1,ACCESS
	BRA	SYSWAITLOOP2
;TXREG = SERDATA
	MOVFF	SERDATA,TX1REG
	BANKSEL	0
	RETURN

;********************************************************************************

;SOURCE: 010_18F67K40_EXPLORER8_GLCD_SETUPVERIFICATION.GCB (274)
GLOBAL	INITGLCD_LT686
INITGLCD_LT686:
;HARWARE SPI MODE
;SPIMODE HWSPIMODESCRIPT, 0
	MOVLW	13
	MOVWF	SPICURRENTMODE,ACCESS
	CLRF	SPICLOCKMODE,ACCESS
	RCALL	SPIMODE764
;SET LT686_CS ON
	BSF	LATA,0,ACCESS
;WAIT 50 MS
	MOVLW	50
	MOVWF	SYSWAITTEMPMS,ACCESS
	CLRF	SYSWAITTEMPMS_H,ACCESS
	RCALL	DELAY_MS
;SET LT686_RST ON
	BSF	LATB,0,ACCESS
;WAIT 15 MS
	MOVLW	15
	MOVWF	SYSWAITTEMPMS,ACCESS
	CLRF	SYSWAITTEMPMS_H,ACCESS
	RCALL	DELAY_MS
;SET LT686_RST OFF
	BCF	LATB,0,ACCESS
;WAIT 15 US
	MOVLW	80
	MOVWF	DELAYTEMP,ACCESS
GLOBAL	DELAYUS1
DELAYUS1:
	DECFSZ	DELAYTEMP,F,ACCESS
	BRA	DELAYUS1
;SET LT686_RST ON
	BSF	LATB,0,ACCESS
;WAIT 15 MS
	MOVLW	15
	MOVWF	SYSWAITTEMPMS,ACCESS
	CLRF	SYSWAITTEMPMS_H,ACCESS
	RCALL	DELAY_MS
;SENDCOMMAND_LT686(0XEF)
;SENDDATA_LT686(0X03)
;GLCDBACKGROUND = TFT_BLACK
	CLRF	GLCDBACKGROUND,ACCESS
	CLRF	GLCDBACKGROUND_H,ACCESS
;GLCDFOREGROUND = TFT_WHITE
	SETF	GLCDFOREGROUND,ACCESS
	SETF	GLCDFOREGROUND_H,ACCESS
;LT686_GLCD_WIDTH = GLCD_WIDTH
	CLRF	GLCDDEVICEWIDTH,ACCESS
	MOVLW	4
	MOVWF	GLCDDEVICEWIDTH_H,ACCESS
;LT686_GLCD_HEIGHT = GLCD_HEIGHT
	MOVLW	32
	MOVWF	GLCDDEVICEHEIGHT,ACCESS
	MOVLW	3
	MOVWF	GLCDDEVICEHEIGHT_H,ACCESS
;GLCDFONTWIDTH = 6
	MOVLW	6
	MOVWF	GLCDFONTWIDTH,ACCESS
;GLCDFNTDEFAULT = 0
	CLRF	GLCDFNTDEFAULT,ACCESS
;GLCDFNTDEFAULTSIZE = 1
	MOVLW	1
	MOVWF	GLCDFNTDEFAULTSIZE,ACCESS
;GLCDFNTDEFAULTHEIGHT = 7   //~ USED BY GLCDPRINTSTRING AND GLCDPRINTSTRINGLN
	MOVLW	7
	MOVWF	GLCDFNTDEFAULTHEIGHT,ACCESS
;GLCDROTATESTATE = PORTRAIT
	MOVLW	4
	MOVWF	GLCDROTATESTATE,ACCESS
;GLCDCLS
	BRA	GLCDCLS_LT686

;********************************************************************************

;SOURCE: LCD.H (583)
GLOBAL	INITLCD
INITLCD:
;ASM SHOWDEBUG  `LCD_IO SELECTED IS ` LCD_IO
;ASM SHOWDEBUG  `LCD_SPEED IS FAST`
;ASM SHOWDEBUG  `OPTIMAL IS SET TO ` OPTIMAL
;ASM SHOWDEBUG  `LCD_SPEED IS SET TO ` LCD_SPEED
;LCD_SPI_EXPANDER_INITIALIZE
	RCALL	LCD_SPI_EXPANDER_INITIALIZE
;LCD_STATE = 12
	MOVLW	12
	MOVWF	LCD_STATE,ACCESS
	RETURN

;********************************************************************************

;SOURCE: 010_18F67K40_EXPLORER8_GLCD_SETUPVERIFICATION.GCB (28)
GLOBAL	INITPPS
INITPPS:
;RC6PPS = 0X000C     //~ TX1 > RC6
	MOVLW	12
	BANKSEL	RC6PPS
	MOVWF	RC6PPS,BANKED
;THIS IS CONDITIONAL TO SUPPORT HARDWARE SPI
;SSP1CLKPPS = 0X13;   //RC3->MSSP1:SCK1;
	MOVLW	19
	MOVWF	SSP1CLKPPS,BANKED
;RC3PPS = 0X19;   //RC3->MSSP1:SCK1;
	MOVLW	25
	MOVWF	RC3PPS,BANKED
;RC5PPS = 0X1A;   //RC5->MSSP1:SDO1;
	MOVLW	26
	MOVWF	RC5PPS,BANKED
;SSP1DATPPS = 0X14;   //RC4->MSSP1:SDI1;
	MOVLW	20
	MOVWF	SSP1DATPPS,BANKED
;RC2PPS = 0X0005     //~ CCP1 > RC2
	MOVLW	5
	MOVWF	RC2PPS,BANKED
;CCP1PPS = 0X0012     //~ RC2 > CCP1 (BI-DIRECTIONAL)
	MOVLW	18
	MOVWF	CCP1PPS,BANKED
;RE5PPS = 0X0005     //~ CCP1 > RE5
	MOVLW	5
	MOVWF	RE5PPS,BANKED
;CCP1PPS = 0X0025     //~ RE5 > CCP1 (BI-DIRECTIONAL)
	MOVLW	37
	MOVWF	CCP1PPS,BANKED
;RE7PPS = 0X0005     //~ CCP1 > RE7
	MOVLW	5
	MOVWF	RE7PPS,BANKED
;CCP1PPS = 0X0027     //~ RE7 > CCP1 (BI-DIRECTIONAL)
	MOVLW	39
	MOVWF	CCP1PPS,BANKED
	BANKSEL	0
	RETURN

;********************************************************************************

;SOURCE: SYSTEM.H (174)
GLOBAL	INITSYS
INITSYS:
;ADDED (PER  CHIP ERRATA SHEETS) TO CORRECTLY SUPPORT TABLE READS ON SPECIFIC CHIPS)
;SETS NVRAM POINTER TO STATIC RAM AS DEFAULT LOCATION.
;NVMCON1.7 = 1
	BSF	NVMCON1,7,ACCESS
;NVMCON1.6 = 0
	BCF	NVMCON1,6,ACCESS
;CLEAR BSR
;MOVLB 0
	MOVLB	0
;ASM SHOWDEBUG THIS CODE BLOCK SETS THE INTERNAL OSCILLATOR TO CHIPMHZ
;ASM SHOWDEBUG DEFAULT SETTINGS FOR MICROCONTROLLERS WITH _OSCCON1_
	;DEFAULT	OSCCON1,NOSC HFINTOSC; NDIV 1 - COMMON AS THIS SIMPLY SETS THE HFINTOSC
;OSCCON1 = 0X60
	MOVLW	96
	BANKSEL	OSCCON1
	MOVWF	OSCCON1,BANKED
;DEFAULT VALUE TYPICALLY, CSWHOLD MAY PROCEED; SOSCPWR LOW POWER
;OSCCON3 = 0X00
	CLRF	OSCCON3,BANKED
;DEFAULT VALUE TYPICALLY, MFOEN DISABLED; LFOEN DISABLED; ADOEN DISABLED; SOSCEN DISABLED; EXTOEN DISABLED; HFOEN DISABLED
;OSCEN = 0X00
	CLRF	OSCEN,BANKED
;DEFAULT VALUE
;OSCTUNE = 0X00
	CLRF	OSCTUNE,BANKED
;ASM SHOWDEBUG THE MCU IS A CHIP FAMILY CHIPFAMILY
;SECTION SUPPORTS MANY MCUS, 18FXXK40, 18FXXK42 ETC THAT HAVE NDIV3 BIT
;ASM SHOWDEBUG OSCCON TYPE IS 101
;OSCCON1 = 0X60
	MOVLW	96
	MOVWF	OSCCON1,BANKED
;CLEAR NDIV3:0
;NDIV3 = 0
	BCF	OSCCON1,3,BANKED
;NDIV2 = 0
	BCF	OSCCON1,2,BANKED
;NDIV1 = 0
	BCF	OSCCON1,1,BANKED
;NDIV0 = 0
	BCF	OSCCON1,0,BANKED
;OSCFRQ = 0B00001000  '64MHZ
	MOVLW	8
	MOVWF	OSCFRQ,BANKED
;ASM SHOWDEBUG _COMPLETE_THE_CHIP_SETUP_OF_BSR_ADCS_ANSEL_AND_OTHER_KEY_SETUP_REGISTERS_OR_REGISTER_BITS
;CLEAR TBLPTRU
;TBLPTRU = 0
	CLRF	TBLPTRU,ACCESS
;ENSURE ALL PORTS ARE SET FOR DIGITAL I/O AND, TURN OFF A/D
;SET ADFM OFF
	BCF	ADCON0,2,ACCESS
;SWITCH OFF A/D VAR(ADCON0)
;SET ADCON0.ADON OFF
	BCF	ADCON0,7,ACCESS
;ANSELA = 0
	CLRF	ANSELA,BANKED
;ANSELB = 0
	CLRF	ANSELB,BANKED
;ANSELD = 0
	CLRF	ANSELD,BANKED
;ANSELE = 0
	CLRF	ANSELE,BANKED
;ANSELF = 0
	CLRF	ANSELF,BANKED
;ANSELG = 0
	CLRF	ANSELG,BANKED
;SET COMPARATOR REGISTER BITS FOR MANY MCUS WITH REGISTER CM2CON0
;C2EN = 0
	BCF	CM2CON0,7,BANKED
;C1EN = 0
	BCF	CM1CON0,7,BANKED
;
;'TURN OFF ALL PORTS
;PORTA = 0
	CLRF	PORTA,ACCESS
;PORTB = 0
	CLRF	PORTB,ACCESS
;PORTC = 0
	CLRF	PORTC,ACCESS
;PORTD = 0
	CLRF	PORTD,ACCESS
;PORTE = 0
	CLRF	PORTE,ACCESS
;PORTF = 0
	CLRF	PORTF,ACCESS
;PORTG = 0
	CLRF	PORTG,ACCESS
;PORTH = 0
	CLRF	PORTH,ACCESS
	BANKSEL	0
	RETURN

;********************************************************************************

;SOURCE: USART.H (1010)
GLOBAL	INITUSART
INITUSART:
;SET THE DEFAULT VALUE FOR USART HANDLER - REQUIRED WHEN MORE THAN ONE USART
;COMPORT = 1
	MOVLW	1
	MOVWF	COMPORT,ACCESS
;PIC USART 1 INIT
;SET BAUD RATE FOR CHIPS WITH BRG16 BIT
;SPBRGH = SPBRGH_TEMP
	MOVLW	6
	MOVWF	SP1BRGH,ACCESS
;SPBRGL = SPBRGL_TEMP
	MOVLW	129
	MOVWF	SP1BRG,ACCESS
;SPBRG = SPBRGL_TEMP
	MOVLW	129
	MOVWF	SP1BRG,ACCESS
;BRG16 = BRG16_TEMP
	BSF	BAUD1CON,3,ACCESS
;BRGH = BRGH_TEMP
	BSF	TX1STA,2,ACCESS
;SYNC=0
	BCF	TX1STA,4,ACCESS
;TXEN=1
	BSF	TX1STA,5,ACCESS
;SPEN=1
	BSF	RC1STA,7,ACCESS
;CREN=1
	BSF	RC1STA,4,ACCESS
	RETURN

;********************************************************************************

;SOURCE: LCD.H (532)
GLOBAL	LCDCMD
LCDCMD:
;SUB TO SEND SPECIFIED COMMAND DIRECT TO THE LCD
;SET LCD_RS OFF
	BCF	SYSLCDTEMP,1,ACCESS
;LCDWRITEBYTE ( LCDVALUE)
	MOVFF	LCDVALUE,LCDBYTE
	RCALL	LCD_SPI_EXPANDER_NORMALWRITEBYTE
;IF LCDVALUE = 1 OR LCDVALUE = 2 THEN  ' HOME OR CLEAR
	MOVFF	LCDVALUE,SYSBYTETEMPA
	MOVLW	1
	MOVWF	SYSBYTETEMPB,ACCESS
	RCALL	SYSCOMPEQUAL
	MOVFF	SYSBYTETEMPX,SYSTEMP1
	MOVFF	LCDVALUE,SYSBYTETEMPA
	MOVLW	2
	MOVWF	SYSBYTETEMPB,ACCESS
	RCALL	SYSCOMPEQUAL
	MOVF	SYSTEMP1,W,ACCESS
	IORWF	SYSBYTETEMPX,W,ACCESS
	MOVWF	SYSTEMP2,ACCESS
	BTFSS	SYSTEMP2,0,ACCESS
	BRA	ELSE14_1
;WAIT 2 MS ' MUST BE > 1.52 MS
	MOVLW	2
	MOVWF	SYSWAITTEMPMS,ACCESS
	CLRF	SYSWAITTEMPMS_H,ACCESS
	RCALL	DELAY_MS
;ELSE
	BRA	ENDIF14
GLOBAL	ELSE14_1
ELSE14_1:
;WAIT 50 US
	MOVLW	1
	MOVWF	DELAYTEMP2,ACCESS
GLOBAL	DELAYUSO7
DELAYUSO7:
	CLRF	DELAYTEMP,ACCESS
GLOBAL	DELAYUS7
DELAYUS7:
	DECFSZ	DELAYTEMP,F,ACCESS
	BRA	DELAYUS7
	DECFSZ	DELAYTEMP2,F,ACCESS
	BRA	DELAYUSO7
	MOVLW	9
	MOVWF	DELAYTEMP,ACCESS
GLOBAL	DELAYUS8
DELAYUS8:
	DECFSZ	DELAYTEMP,F,ACCESS
	BRA	DELAYUS8
;END IF
GLOBAL	ENDIF14
ENDIF14:
	RETURN

;********************************************************************************

;SOURCE: LCD.H (2452)
GLOBAL	LCD_SPI_EXPANDER_INITIALIZE
LCD_SPI_EXPANDER_INITIALIZE:
;DIR LCD_SPI_RESET_OUT OUT
	BCF	TRISB,5,ACCESS
;'RESET THE EXPANDER
;RESET SEQUENCE (LOWER LINE FOR AT LEAST 1 US)
;WAIT 10 MS
	MOVLW	10
	MOVWF	SYSWAITTEMPMS,ACCESS
	CLRF	SYSWAITTEMPMS_H,ACCESS
	RCALL	DELAY_MS
;LCD_SPI_RESET_OUT = 0
	BCF	LATB,5,ACCESS
;WAIT 5 US
	MOVLW	26
	MOVWF	DELAYTEMP,ACCESS
GLOBAL	DELAYUS6
DELAYUS6:
	DECFSZ	DELAYTEMP,F,ACCESS
	BRA	DELAYUS6
	NOP
;LCD_SPI_RESET_OUT = 1
	BSF	LATB,5,ACCESS
;DIR LCD_SPI_CS      OUT
	BCF	TRISA,2,ACCESS
;DIR LCD_SPI_DO      OUT
	BCF	TRISC,5,ACCESS
;DIR LCD_SPI_SCK     OUT
	BCF	TRISC,3,ACCESS
;ASM SHOWDEBUG SPI CONSTANT USED EQUATES TO HWSPIMODESCRIPT
;SPIMODE HWSPIMODESCRIPT, 0
	MOVLW	13
	MOVWF	SPICURRENTMODE,ACCESS
	CLRF	SPICLOCKMODE,ACCESS
	RCALL	SPIMODE764
;LCD_SPI_WRITEIOEXPANDER(IO_DIR_A_ADDRESS, OUTPUT_DIR)
	CLRF	__LCDREG,ACCESS
	CLRF	__LCDBYTE,ACCESS
	RCALL	LCD_SPI_WRITEIOEXPANDER
;WAIT 10 MS
	MOVLW	10
	MOVWF	SYSWAITTEMPMS,ACCESS
	CLRF	SYSWAITTEMPMS_H,ACCESS
	RCALL	DELAY_MS
;LCD_SPI_WRITEIOEXPANDER(IO_DIR_B_ADDRESS, OUTPUT_DIR)
	MOVLW	1
	MOVWF	__LCDREG,ACCESS
	CLRF	__LCDBYTE,ACCESS
	RCALL	LCD_SPI_WRITEIOEXPANDER
;WAIT 10 MS
	MOVLW	10
	MOVWF	SYSWAITTEMPMS,ACCESS
	CLRF	SYSWAITTEMPMS_H,ACCESS
	RCALL	DELAY_MS
;LCD_SPI_WRITEIOEXPANDER(GPIO_A_ADDRESS, LCD_VDD_EN)
	MOVLW	18
	MOVWF	__LCDREG,ACCESS
	MOVLW	32
	MOVWF	__LCDBYTE,ACCESS
	RCALL	LCD_SPI_WRITEIOEXPANDER
;WAIT 10 MS
	MOVLW	10
	MOVWF	SYSWAITTEMPMS,ACCESS
	CLRF	SYSWAITTEMPMS_H,ACCESS
	RCALL	DELAY_MS
;LCDCMD(LCD_FUNCTION_SET)
	MOVLW	60
	MOVWF	LCDVALUE,ACCESS
	RCALL	LCDCMD
;WAIT 10 MS;
	MOVLW	10
	MOVWF	SYSWAITTEMPMS,ACCESS
	CLRF	SYSWAITTEMPMS_H,ACCESS
	RCALL	DELAY_MS
;LCDCMD(LCD_SET_DISPLAY)
	MOVLW	12
	MOVWF	LCDVALUE,ACCESS
	RCALL	LCDCMD
;WAIT 10 MS;
	MOVLW	10
	MOVWF	SYSWAITTEMPMS,ACCESS
	CLRF	SYSWAITTEMPMS_H,ACCESS
	RCALL	DELAY_MS
;LCDCMD(LCD_CLEAR)
	MOVLW	1
	MOVWF	LCDVALUE,ACCESS
	RCALL	LCDCMD
;WAIT 10 MS;
	MOVLW	10
	MOVWF	SYSWAITTEMPMS,ACCESS
	CLRF	SYSWAITTEMPMS_H,ACCESS
	RCALL	DELAY_MS
;LCDCMD(LCD_SET_DISPLAY)
	MOVLW	12
	MOVWF	LCDVALUE,ACCESS
	RCALL	LCDCMD
;WAIT 130 MS
	MOVLW	130
	MOVWF	SYSWAITTEMPMS,ACCESS
	CLRF	SYSWAITTEMPMS_H,ACCESS
	RCALL	DELAY_MS
;LCDCMD(LCD_SET_DDRAM_ADDRESS)
	MOVLW	128
	MOVWF	LCDVALUE,ACCESS
	RCALL	LCDCMD
;WAIT 1 MS
	MOVLW	1
	MOVWF	SYSWAITTEMPMS,ACCESS
	CLRF	SYSWAITTEMPMS_H,ACCESS
	BRA	DELAY_MS

;********************************************************************************

;SOURCE: LCD.H (2404)
GLOBAL	LCD_SPI_EXPANDER_NORMALWRITEBYTE
LCD_SPI_EXPANDER_NORMALWRITEBYTE:
;SUB TO WRITE A BYTE TO THE LCD
;DEFAULT VALUES - THESE ARE THE ADDRESS ON THE EXPANDER
;LCD_SPI_EXPANDER_ENABLED = 0X20
;LCD_SPI_EXPANDER_E_ADDRESS = 0X40
;LCD_SPI_EXPANDER_RS_ADDRESS = 0X80
;
;DIM LCD_STATE AS BYTE
;IF LCD_RS = 0 THEN
	BTFSC	SYSLCDTEMP,1,ACCESS
	BRA	ELSE4_1
;R
;SE
;LCD_SPI_WRITEIOEXPANDER(GPIO_A_ADDRESS, LCD_SPI_EXPANDER_ENABLED + LCD_SPI_EXPANDER_E_ADDRESS); //RS LOW -- E HIGH -- LCD ENABLED 01100000
	MOVLW	18
	MOVWF	__LCDREG,ACCESS
	MOVLW	96
	MOVWF	__LCDBYTE,ACCESS
	RCALL	LCD_SPI_WRITEIOEXPANDER
;LCD_SPI_WRITEIOEXPANDER(GPIO_B_ADDRESS, LCDBYTE); //WRITE THE COMMAND ON PORT B E
	MOVLW	19
	MOVWF	__LCDREG,ACCESS
	MOVFF	LCDBYTE,__LCDBYTE
	RCALL	LCD_SPI_WRITEIOEXPANDER
	MOVFF	__LCDBYTE,LCDBYTE
;LCD_SPI_WRITEIOEXPANDER(GPIO_A_ADDRESS, LCD_SPI_EXPANDER_ENABLED); //RS LOW -- E LOW -- LCD ENABLED 00100000
	MOVLW	18
	MOVWF	__LCDREG,ACCESS
	MOVLW	32
	MOVWF	__LCDBYTE,ACCESS
	RCALL	LCD_SPI_WRITEIOEXPANDER
;ELSE
	BRA	ENDIF4
GLOBAL	ELSE4_1
ELSE4_1:
;R
;SE
;11100000
;LCD_SPI_WRITEIOEXPANDER(GPIO_A_ADDRESS, LCD_SPI_EXPANDER_ENABLED + LCD_SPI_EXPANDER_E_ADDRESS + LCD_SPI_EXPANDER_RS_ADDRESS ); //RS HIGH -- E HIGH -- LCD ENABLED --> THIS IS TO CHOOSE THE DATA REGISTER ON THE LCD
	MOVLW	18
	MOVWF	__LCDREG,ACCESS
	MOVLW	224
	MOVWF	__LCDBYTE,ACCESS
	RCALL	LCD_SPI_WRITEIOEXPANDER
;LCD_SPI_WRITEIOEXPANDER(GPIO_B_ADDRESS, LCDBYTE); //WRITE THE BYTE ON PORT B
	MOVLW	19
	MOVWF	__LCDREG,ACCESS
	MOVFF	LCDBYTE,__LCDBYTE
	RCALL	LCD_SPI_WRITEIOEXPANDER
	MOVFF	__LCDBYTE,LCDBYTE
;R
;SE
;10100000
;LCD_SPI_WRITEIOEXPANDER(GPIO_A_ADDRESS, LCD_SPI_EXPANDER_ENABLED + LCD_SPI_EXPANDER_RS_ADDRESS ); //RS HIGH -- E LOW -- LCD ENABLED --> THIS IS TO LATCH THE DATA ON THE LCD
	MOVLW	18
	MOVWF	__LCDREG,ACCESS
	MOVLW	160
	MOVWF	__LCDBYTE,ACCESS
	RCALL	LCD_SPI_WRITEIOEXPANDER
;END IF
GLOBAL	ENDIF4
ENDIF4:
;LCD_STATE = 12
	MOVLW	12
	MOVWF	LCD_STATE,ACCESS
;WAIT LCD_SPEED US
	MOVLW	1
	MOVWF	DELAYTEMP2,ACCESS
GLOBAL	DELAYUSO4
DELAYUSO4:
	CLRF	DELAYTEMP,ACCESS
GLOBAL	DELAYUS4
DELAYUS4:
	DECFSZ	DELAYTEMP,F,ACCESS
	BRA	DELAYUS4
	DECFSZ	DELAYTEMP2,F,ACCESS
	BRA	DELAYUSO4
	MOVLW	9
	MOVWF	DELAYTEMP,ACCESS
GLOBAL	DELAYUS5
DELAYUS5:
	DECFSZ	DELAYTEMP,F,ACCESS
	BRA	DELAYUS5
;IF REGISTER SELECT IS LOW
;IF LCD_RS = 0 THEN
	BTFSC	SYSLCDTEMP,1,ACCESS
	BRA	ENDIF5
;IF LCDBYTE < 16 THEN
	MOVLW	16
	SUBWF	LCDBYTE,W,ACCESS
	BTFSC	STATUS,0,ACCESS
	BRA	ENDIF6
;IF LCDBYTE > 7 THEN
	MOVF	LCDBYTE,W,ACCESS
	SUBLW	7
	BTFSS	STATUS,0,ACCESS
;LCD_STATE = LCDBYTE
	MOVFF	LCDBYTE,LCD_STATE
;END IF
;END IF
GLOBAL	ENDIF6
ENDIF6:
;END IF
GLOBAL	ENDIF5
ENDIF5:
	RETURN

;********************************************************************************

;SOURCE: LCD.H (2498)
GLOBAL	LCD_SPI_WRITEIOEXPANDER
LCD_SPI_WRITEIOEXPANDER:
;LCD_SPI_CS = 0
	BCF	LATA,2,ACCESS
;SET THE THREE PARAMETERS USING BIT BANGING
;DIM __LCD_OUTBUFFER, __LCD_OUTBUFFERCOUNT
;FOR __LCD_OUTBUFFERCOUNT = 0 TO 2
;LEGACY METHOD
	SETF	__LCD_OUTBUFFERCOUNT,ACCESS
GLOBAL	SYSFORLOOP2
SYSFORLOOP2:
	INCF	__LCD_OUTBUFFERCOUNT,F,ACCESS
;SELECT CASE __LCD_OUTBUFFERCOUNT
;CASE 0: __LCD_OUTBUFFER = LCD_SPI_EXPD_ADDRESS
GLOBAL	SYSSELECT1CASE1
SYSSELECT1CASE1:
	MOVF	__LCD_OUTBUFFERCOUNT,F,ACCESS
	BTFSS	STATUS,2,ACCESS
	BRA	SYSSELECT1CASE2
;CASE 0: __LCD_OUTBUFFER = LCD_SPI_EXPD_ADDRESS
	MOVLW	64
	MOVWF	__LCD_OUTBUFFER,ACCESS
;CASE 1: __LCD_OUTBUFFER = __LCDREG
	BRA	SYSSELECTEND1
GLOBAL	SYSSELECT1CASE2
SYSSELECT1CASE2:
	DECF	__LCD_OUTBUFFERCOUNT,W,ACCESS
	BTFSS	STATUS,2,ACCESS
	BRA	SYSSELECT1CASE3
;CASE 1: __LCD_OUTBUFFER = __LCDREG
	MOVFF	__LCDREG,__LCD_OUTBUFFER
;CASE 2: __LCD_OUTBUFFER = __LCDBYTE
	BRA	SYSSELECTEND1
GLOBAL	SYSSELECT1CASE3
SYSSELECT1CASE3:
	MOVLW	2
	SUBWF	__LCD_OUTBUFFERCOUNT,W,ACCESS
	BTFSS	STATUS,2,ACCESS
	BRA	SYSSELECTEND1
;CASE 2: __LCD_OUTBUFFER = __LCDBYTE
	MOVFF	__LCDBYTE,__LCD_OUTBUFFER
;END SELECT
GLOBAL	SYSSELECTEND1
SYSSELECTEND1:
;REPEAT 8
	MOVLW	8
	MOVWF	SYSREPEATTEMP1,ACCESS
GLOBAL	SYSREPEATLOOP1
SYSREPEATLOOP1:
;IF __LCD_OUTBUFFER.7 = ON  THEN
	BTFSS	__LCD_OUTBUFFER,7,ACCESS
	BRA	ELSE8_1
;SET LCD_SPI_DO ON;
	BSF	LATC,5,ACCESS
;ELSE
	BRA	ENDIF8
GLOBAL	ELSE8_1
ELSE8_1:
;SET LCD_SPI_DO OFF;
	BCF	LATC,5,ACCESS
;END IF
GLOBAL	ENDIF8
ENDIF8:
;SET LCD_SPI_SCK ON;
	BSF	LATC,3,ACCESS
;ROTATE __LCD_OUTBUFFER LEFT
	RLCF	__LCD_OUTBUFFER,F,ACCESS
;SET LCD_SPI_SCK OFF;
	BCF	LATC,3,ACCESS
;END REPEAT
	DECFSZ	SYSREPEATTEMP1,F,ACCESS
	BRA	SYSREPEATLOOP1
GLOBAL	SYSREPEATLOOPEND1
SYSREPEATLOOPEND1:
;NEXT
	MOVLW	2
	SUBWF	__LCD_OUTBUFFERCOUNT,W,ACCESS
	BTFSS	STATUS,0,ACCESS
	BRA	SYSFORLOOP2
GLOBAL	SYSFORLOOPEND2
SYSFORLOOPEND2:
;LCD_SPI_CS = 1
	BSF	LATA,2,ACCESS
	RETURN

;********************************************************************************

;SOURCE: LCD.H (496)
GLOBAL	LOCATE
LOCATE:
;SUB TO LOCATE THE CURSOR
;WHERE LCDCOLUMN IS 0 TO SCREEN WIDTH-1, LCDLINE IS 0 TO SCREEN HEIGHT-1
;SET LCD_RS OFF
	BCF	SYSLCDTEMP,1,ACCESS
;IF LCDLINE > 1 THEN
	MOVF	LCDLINE,W,ACCESS
	SUBLW	1
	BTFSC	STATUS,0,ACCESS
	BRA	ENDIF1
;LCDLINE = LCDLINE - 2
	MOVLW	2
	SUBWF	LCDLINE,F,ACCESS
;LCDCOLUMN = LCDCOLUMN + LCD_WIDTH
	MOVLW	20
	ADDWF	LCDCOLUMN,F,ACCESS
;END IF
GLOBAL	ENDIF1
ENDIF1:
;LCDWRITEBYTE(0X80 OR 0X40 * LCDLINE + LCDCOLUMN)
	MOVF	LCDLINE,W,ACCESS
	MULLW	64
	MOVF	LCDCOLUMN,W,ACCESS
	ADDWF	PROD,W,ACCESS
	MOVWF	SYSTEMP1,ACCESS
	MOVLW	128
	IORWF	SYSTEMP1,W,ACCESS
	MOVWF	LCDBYTE,ACCESS
	RCALL	LCD_SPI_EXPANDER_NORMALWRITEBYTE
;WAIT 5 10US
	MOVLW	5
	MOVWF	SYSWAITTEMP10US,ACCESS
	BRA	DELAY_10US

;********************************************************************************

;OVERLOADED SIGNATURE: STRING:, SOURCE: LCD.H (935)
GLOBAL	PRINT612
PRINT612:
;SUB TO PRINT A STRING VARIABLE ON THE LCD
;PRINTLEN = PRINTDATA(0)
	MOVFF	SYSPRINTDATAHANDLER,FSR0
	MOVFF	SYSPRINTDATAHANDLER_H,FSR0H
	MOVFF	INDF0,PRINTLEN
;IF PRINTLEN = 0 THEN EXIT SUB
	MOVF	PRINTLEN,F,ACCESS
	BTFSC	STATUS,2,ACCESS
;IF PRINTLEN = 0 THEN EXIT SUB
	RETURN
;IF PRINTLEN = 0 THEN EXIT SUB
;SET LCD_RS ON
	BSF	SYSLCDTEMP,1,ACCESS
;WRITE DATA
;FOR SYSPRINTTEMP = 1 TO PRINTLEN
	MOVLW	1
	MOVWF	SYSPRINTTEMP,ACCESS
GLOBAL	SYSFORLOOP1
SYSFORLOOP1:
;LCDWRITEBYTE PRINTDATA(SYSPRINTTEMP)
	MOVF	SYSPRINTTEMP,W,ACCESS
	ADDWF	SYSPRINTDATAHANDLER,W,ACCESS
	MOVWF	FSR0,ACCESS
	MOVLW	0
	ADDWFC	SYSPRINTDATAHANDLER_H,W,ACCESS
	MOVWF	FSR0H,ACCESS
	MOVFF	INDF0,LCDBYTE
	RCALL	LCD_SPI_EXPANDER_NORMALWRITEBYTE
;NEXT
;POSITIVE VALUE STEP HANDLER IN FOR-NEXT STATEMENT :#4P 
	MOVF	SYSPRINTTEMP,W,ACCESS
	SUBWF	PRINTLEN,W,ACCESS
	MOVWF	SYSTEMP1,ACCESS
	MOVFF	SYSTEMP1,SYSBYTETEMPA
	CLRF	SYSBYTETEMPB,ACCESS
	RCALL	SYSCOMPEQUAL
	COMF	SYSBYTETEMPX,F,ACCESS
	BTFSS	SYSBYTETEMPX,0,ACCESS
	BRA	ENDIF3
;SET LOOPVAR TO LOOPVAR + STEPVALUE WHERE STEPVALUE IS A POSITIVE VALUE
	INCF	SYSPRINTTEMP,F,ACCESS
	BRA	SYSFORLOOP1
;END IF
GLOBAL	ENDIF3
ENDIF3:
GLOBAL	SYSFORLOOPEND1
SYSFORLOOPEND1:
	RETURN

;********************************************************************************

;OVERLOADED SIGNATURE: BYTE:BYTE:, SOURCE: HWSPI.H (382)
GLOBAL	SPIMODE764
SPIMODE764:
;SUPPORTS LEGACY SPI VIA MSSP MODULE
;ADDED FOR 16F18855
;ADDED FOR 16F18855
;ADDED FOR 16F18855
;TURN OFF SPI
;(PREVENTS ANY WEIRD GLITCHES DURING SETUP)
;SET SSPCON1.SSPEN OFF ;(PREVENTS ANY WEIRD GLITCHES DURING SETUP)
	BCF	SSP1CON1,5,ACCESS
;SET CLOCK PULSE SETTINGS
;SET SSPSTAT.SMP OFF
	BCF	SSP1STAT,7,ACCESS
;SET SSPSTAT.CKE OFF
	BCF	SSP1STAT,6,ACCESS
;IF SPICLOCKMODE.0 = OFF THEN
	BTFSS	SPICLOCKMODE,0,ACCESS
;SET SSPSTAT.CKE ON
	BSF	SSP1STAT,6,ACCESS
;END IF
;SET SSPCON1.CKP OFF
	BCF	SSP1CON1,4,ACCESS
;IF SPICLOCKMODE.1 = ON THEN
	BTFSC	SPICLOCKMODE,1,ACCESS
;SET SSPCON1.CKP ON
	BSF	SSP1CON1,4,ACCESS
;END IF
;SELECT MODE AND CLOCK
;SET SOME MODE BITS OFF, CAN SET ON LATER
;SET SSPCON1.SSPM3 OFF
	BCF	SSP1CON1,3,ACCESS
;SET SSPCON1.SSPM2 OFF
	BCF	SSP1CON1,2,ACCESS
;SET SSPCON1.SSPM1 OFF
	BCF	SSP1CON1,1,ACCESS
;SET SSPCON1.SSPM0 OFF
	BCF	SSP1CON1,0,ACCESS
;SELECT CASE SPICURRENTMODE
;CASE MASTERSSPADDMODE   '1010
GLOBAL	SYSSELECT2CASE1
SYSSELECT2CASE1:
	MOVLW	16
	SUBWF	SPICURRENTMODE,W,ACCESS
	BTFSS	STATUS,2,ACCESS
	BRA	SYSSELECT2CASE2
;SET SSPCON1.SSPM3 ON
	BSF	SSP1CON1,3,ACCESS
;SET SSPCON1.SSPM1 ON
	BSF	SSP1CON1,1,ACCESS
;SSP1ADD = 1
	MOVLW	1
	MOVWF	SSP1ADD,ACCESS
;CASE MASTERULTRAFAST
	BRA	SYSSELECTEND2
GLOBAL	SYSSELECT2CASE2
SYSSELECT2CASE2:
	MOVLW	14
	SUBWF	SPICURRENTMODE,W,ACCESS
	BTFSS	STATUS,2,ACCESS
	BRA	SYSSELECT2CASE3
;NOTHING TO DO ON PIC
;CASE MASTERFAST
	BRA	SYSSELECTEND2
GLOBAL	SYSSELECT2CASE3
SYSSELECT2CASE3:
	MOVLW	13
	SUBWF	SPICURRENTMODE,W,ACCESS
	BTFSS	STATUS,2,ACCESS
	BRA	SYSSELECT2CASE4
;NOTHING TO DO
;CASE MASTER
	BRA	SYSSELECTEND2
GLOBAL	SYSSELECT2CASE4
SYSSELECT2CASE4:
	MOVLW	12
	SUBWF	SPICURRENTMODE,W,ACCESS
	BTFSS	STATUS,2,ACCESS
	BRA	SYSSELECT2CASE5
;SET SSPCON1.SSPM0 ON
	BSF	SSP1CON1,0,ACCESS
;CASE MASTERSLOW
	BRA	SYSSELECTEND2
GLOBAL	SYSSELECT2CASE5
SYSSELECT2CASE5:
	MOVLW	11
	SUBWF	SPICURRENTMODE,W,ACCESS
	BTFSS	STATUS,2,ACCESS
	BRA	SYSSELECT2CASE6
;SET SSPCON1.SSPM1 ON
	BSF	SSP1CON1,1,ACCESS
;CASE SLAVE
	BRA	SYSSELECTEND2
GLOBAL	SYSSELECT2CASE6
SYSSELECT2CASE6:
	MOVF	SPICURRENTMODE,F,ACCESS
	BTFSS	STATUS,2,ACCESS
	BRA	SYSSELECT2CASE7
;SET SSPCON1.SSPM2 ON
	BSF	SSP1CON1,2,ACCESS
;SET SSPCON1.SSPM0 ON
	BSF	SSP1CON1,0,ACCESS
;CASE SLAVESS
	BRA	SYSSELECTEND2
GLOBAL	SYSSELECT2CASE7
SYSSELECT2CASE7:
	DECF	SPICURRENTMODE,W,ACCESS
	BTFSS	STATUS,2,ACCESS
	BRA	SYSSELECTEND2
;SET SSPCON1.SSPM2 ON
	BSF	SSP1CON1,2,ACCESS
;END SELECT
GLOBAL	SYSSELECTEND2
SYSSELECTEND2:
;ENABLE SPI
;SET SSPCON1.SSPEN ON
	BSF	SSP1CON1,5,ACCESS
	RETURN

;********************************************************************************

;SOURCE: SYSTEM.H (3102)
GLOBAL	SYSCOMPEQUAL
SYSCOMPEQUAL:
;DIM SYSBYTETEMPA, SYSBYTETEMPB, SYSBYTETEMPX AS BYTE
;SETF SYSBYTETEMPX
	SETF	SYSBYTETEMPX,ACCESS
;MOVF SYSBYTETEMPB, W
	MOVF	SYSBYTETEMPB, W,ACCESS
;CPFSEQ SYSBYTETEMPA
	CPFSEQ	SYSBYTETEMPA,ACCESS
;CLRF SYSBYTETEMPX
	CLRF	SYSBYTETEMPX,ACCESS
	RETURN

;********************************************************************************

;SOURCE: SYSTEM.H (1595)
GLOBAL	SYSREADSTRING
SYSREADSTRING:
;DIM SYSCALCTEMPA AS BYTE
;DIM SYSSTRINGLENGTH AS BYTE
;CHIPFAMILY 16 SUPPORT
;GET LENGTH
;TBLRD*+
	TBLRD*+
	;MOVFF	TABLAT,SYSCALCTEMPA
	MOVFF	TABLAT,SYSCALCTEMPA
	;MOVFF	TABLAT,INDF1
	MOVFF	TABLAT,INDF1
;GOTO SYSSTRINGREADCHECK
	BRA	SYSSTRINGREADCHECK
GLOBAL	SYSREADSTRINGPART
SYSREADSTRINGPART:
;TBLRD*+
	TBLRD*+
	;MOVF	TABLAT,W
	MOVF	TABLAT, W,ACCESS
;MOVWF SYSCALCTEMPA
	MOVWF	SYSCALCTEMPA,ACCESS
;ADDWF SYSSTRINGLENGTH,F
	ADDWF	SYSSTRINGLENGTH,F,ACCESS
;CHECK LENGTH
GLOBAL	SYSSTRINGREADCHECK
SYSSTRINGREADCHECK:
;IF LENGTH IS 0, EXIT
;MOVF SYSCALCTEMPA,F
	MOVF	SYSCALCTEMPA,F,ACCESS
	;BTFSC	STATUS,2
	BTFSC	STATUS,2,ACCESS
;RETURN
	RETURN
;COPY
GLOBAL	SYSSTRINGREAD
SYSSTRINGREAD:
;COPY CHAR
;TBLRD*+
	TBLRD*+
	;MOVFF	TABLAT,PREINC1
	MOVFF	TABLAT,PREINC1
;DECFSZ SYSCALCTEMPA, F
	DECFSZ	SYSCALCTEMPA, F,ACCESS
;GOTO SYSSTRINGREAD
	BRA	SYSSTRINGREAD
	RETURN

;********************************************************************************

GLOBAL	SYSSTRINGTABLES
SYSSTRINGTABLES:

GLOBAL	STRINGTABLE1
STRINGTABLE1:
	DB	21,87,101,108,99,111,109,101,32,116,111,32,69,120,112,108,111,114,101,114,32,56

	ALIGN	2;X3

GLOBAL	STRINGTABLE2
STRINGTABLE2:
	DB	24,71,67,66,65,83,73,67,32,45,32,65,110,111,98,105,117,109,32,32,32,50,48,50,51

	ALIGN	2;X3

GLOBAL	STRINGTABLE3
STRINGTABLE3:
	DB	16,32,32,32,32,87,101,108,99,111,109,101,32,32,32,32,32

	ALIGN	2;X3

GLOBAL	STRINGTABLE4
STRINGTABLE4:
	DB	16,32,32,116,111,32,69,120,112,108,111,114,101,114,32,56,32

	ALIGN	2;X3

GLOBAL	STRINGTABLE5
STRINGTABLE5:
	DB	16,32,32,32,32,71,67,66,65,83,73,67,32,32,32,32,32

	ALIGN	2;X3

GLOBAL	STRINGTABLE6
STRINGTABLE6:
	DB	16,32,65,110,111,98,105,117,109,32,32,32,50,48,50,51,32

	ALIGN	2;X3

;********************************************************************************

	ALIGN	2;X2
;
; Declare Power-On-Reset entry point
;
 END     RESETVEC
